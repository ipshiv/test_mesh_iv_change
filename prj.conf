## west.yml
```
manifest:
  self:
    path: app-ml
  remotes:
    - name: ncs
      url-base: https://github.com/nrfconnect
  projects:
    - name: nrf
      repo-path: sdk-nrf
      remote: ncs
      revision: v2.3.0
      import: true
```

## prj.conf
```kconfig
#
# Copyright (c) 2019 Nordic Semiconductor ASA
#
# SPDX-License-Identifier: LicenseRef-Nordic-5-Clause
#
CONFIG_NCS_SAMPLES_DEFAULTS=y

# Deffered logging helps improve LPN power consumption
# when friendship is established.
# CONFIG_LOG_MODE_DEFERRED=y >> we need immediate

# General configuration
CONFIG_SYSTEM_WORKQUEUE_STACK_SIZE=8192
CONFIG_FLASH=y
CONFIG_FLASH_MAP=y
CONFIG_NVS=y
CONFIG_SETTINGS=y
CONFIG_HWINFO=y
CONFIG_DK_LIBRARY=y
CONFIG_PM_SINGLE_IMAGE=y
CONFIG_PM_PARTITION_SIZE_SETTINGS_STORAGE=0x8000
CONFIG_SOC_FLASH_NRF_PARTIAL_ERASE=y

# Bluetooth configuration
CONFIG_BT=y
CONFIG_BT_COMPANY_ID=0x0059
CONFIG_BT_DEVICE_NAME="Mesh Light"
CONFIG_BT_L2CAP_TX_MTU=69
CONFIG_BT_L2CAP_TX_BUF_COUNT=8
CONFIG_BT_OBSERVER=y
CONFIG_BT_PERIPHERAL=y
CONFIG_BT_SETTINGS=y
CONFIG_BT_RX_STACK_SIZE=2150

# Disable unused Bluetooth features
CONFIG_BT_CTLR_DUP_FILTER_LEN=0
CONFIG_BT_CTLR_LE_ENC=n
CONFIG_BT_DATA_LEN_UPDATE=n
CONFIG_BT_PHY_UPDATE=n
CONFIG_BT_CTLR_CHAN_SEL_2=n
CONFIG_BT_CTLR_MIN_USED_CHAN=n
CONFIG_BT_CTLR_PRIVACY=n

# Bluetooth mesh configuration
CONFIG_BT_MESH=y
CONFIG_BT_MESH_RELAY=y
CONFIG_BT_MESH_FRIEND=y
CONFIG_BT_MESH_ADV_BUF_COUNT=13
CONFIG_BT_MESH_TX_SEG_MAX=10
CONFIG_BT_MESH_PB_GATT=y
CONFIG_BT_MESH_GATT_PROXY=y
CONFIG_BT_MESH_PROXY_USE_DEVICE_NAME=y
CONFIG_BT_MESH_DK_PROV=y

# IV Update
CONFIG_BT_MESH_IV_UPDATE_TEST=y
# don't update too often
CONFIG_BT_MESH_IV_UPDATE_SEQ_LIMIT=0x0100

# Logs
CONFIG_DEBUG=y
CONFIG_LOG=y
CONFIG_PRINTK=y
CONFIG_LOG_MODE_IMMEDIATE=y
CONFIG_LOG_MODE_MINIMAL=y
CONFIG_LOG_DEFAULT_LEVEL=4
CONFIG_CBPRINTF_FP_SUPPORT=n #Don't use it without serious need, better print %d.%d
CONFIG_LOG_BACKEND_UART=n #Don't forget to config SERIAL
CONFIG_LOG_BACKEND_RTT=y #Don't forget to config USE_SEGGER_RTT
CONFIG_USE_SEGGER_RTT=y
CONFIG_SERIAL=n
## Console
CONFIG_CONSOLE=y
CONFIG_RTT_CONSOLE=y #Don't forget to config USE_SEGGER_RTT
CONFIG_UART_CONSOLE=n #Don't forget to config SERIAL

# BT MESH Debug configurations
# set y for required parts
CONFIG_BT_DEBUG_LOG=y
CONFIG_BT_MESH_LOG_LEVEL_DBG=y
CONFIG_BT_MESH_ACCESS_LOG_LEVEL_DBG=y
CONFIG_BT_MESH_NET_LOG_LEVEL_DBG=y
CONFIG_BT_MESH_ADV_LOG_LEVEL_DBG=n
CONFIG_BT_MESH_BEACON_LOG_LEVEL_DBG=n
CONFIG_BT_MESH_CDB_LOG_LEVEL_DBG=n
CONFIG_BT_MESH_CFG_LOG_LEVEL_DBG=y
CONFIG_BT_MESH_CRYPTO_LOG_LEVEL_DBG=n
CONFIG_BT_MESH_FRIEND_LOG_LEVEL_DBG=n
CONFIG_BT_MESH_KEYS_LOG_LEVEL_DBG=n
CONFIG_BT_MESH_LOW_POWER_LOG_LEVEL_DBG=n
CONFIG_BT_MESH_MODEL_LOG_LEVEL_DBG=y
CONFIG_BT_MESH_PROV_LOG_LEVEL_DBG=n
CONFIG_BT_MESH_PROVISIONER_LOG_LEVEL_DBG=n
CONFIG_BT_MESH_PROXY_LOG_LEVEL_DBG=n
CONFIG_BT_MESH_RPL_LOG_LEVEL_DBG=n
CONFIG_BT_MESH_SETTINGS_LOG_LEVEL_DBG=n
CONFIG_BT_MESH_TRANS_LOG_LEVEL_DBG=n

# Bluetooth mesh models
CONFIG_BT_MESH_ONOFF_SRV=y
```

## src/main.c
```c
/*
 * Copyright (c) 2019 Nordic Semiconductor ASA
 *
 * SPDX-License-Identifier: LicenseRef-Nordic-5-Clause
 */

/** @file
 *  @brief Nordic mesh light sample
 */
#include <zephyr/bluetooth/bluetooth.h>
#include <bluetooth/mesh/models.h>
#include <bluetooth/mesh/dk_prov.h>
#include <dk_buttons_and_leds.h>
#include "model_handler.h"
#include "smp_dfu.h"

#include <zephyr/logging/log.h>
LOG_MODULE_REGISTER(app, CONFIG_LOG_DEFAULT_LEVEL);

static void bt_ready(int err)
{
	if (err) {
		LOG_ERR("Bluetooth init failed (err %d)\n", err);
		return;
	}

	printk("Bluetooth initialized\n");

	dk_leds_init();
	dk_buttons_init(NULL);

	err = bt_mesh_init(bt_mesh_dk_prov_init(), model_handler_init());
	if (err) {
		LOG_ERR("Initializing mesh failed (err %d)\n", err);
		return;
	}

	if (IS_ENABLED(CONFIG_SETTINGS)) {
		settings_load();
	}

	/* This will be a no-op if settings_load() loaded provisioning info */
	bt_mesh_prov_enable(BT_MESH_PROV_ADV | BT_MESH_PROV_GATT);

	LOG_INF("Mesh initialized\n");

	if (IS_ENABLED(CONFIG_SOC_SERIES_NRF52X) &&
	    IS_ENABLED(CONFIG_MCUMGR_SMP_BT)) {
		err = smp_dfu_init();
		if (err) {
			LOG_ERR("Unable to initialize DFU (err %d)\n", err);
		}
	}
}

static void button_handler_cb(uint32_t pressed, uint32_t changed)
{
	if (!bt_mesh_is_provisioned()) {
		return;
	}

	if (IS_ENABLED(CONFIG_BT_MESH_LOW_POWER) &&
	    (pressed & changed & BIT(3))) {
		bt_mesh_proxy_identity_enable();
		return;
	}

	if (pressed & changed & BIT(0)) {
		// start IV
		static bool isEnabled = false;
		bt_mesh_iv_update_test(isEnabled = !isEnabled);
		LOG_INF("bt_mesh_iv_update_test >> set to %s",
			isEnabled ? "ENABLED" : "DISABLED");
	} else if (pressed & changed & BIT(1)) {
		// force update
		LOG_INF("bt_mesh_iv_update >> status %s",
			bt_mesh_iv_update() ? "OK" : "FAILED");
	}
}

void main(void)
{
	int err;

	LOG_INF("Initializing...\n");

	err = bt_enable(bt_ready);
	if (err) {
		LOG_ERR("Bluetooth init failed (err %d)\n", err);
	}

	static struct button_handler button_handler = {
		.cb = button_handler_cb,
	};

	dk_button_handler_add(&button_handler);
}
```
